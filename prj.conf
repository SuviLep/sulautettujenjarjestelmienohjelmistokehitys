## CMakeLists.txt
```
cmake_minimum_required(VERSION 3.20.0)
find_package(Zephyr REQUIRED HINTS $ENV{ZEPHYR_BASE})

project(viikko2)

target_sources(app PRIVATE src/main.c)
```

## prj.conf
```kconfig
# Ota käyttöön kernel-heap k_malloc:ille
CONFIG_HEAP_MEM_POOL_SIZE=4096

CONFIG_MAIN_STACK_SIZE=2048
```

## src/main.c
```c
#include <zephyr/kernel.h>
#include <zephyr/sys/printk.h>
#include <zephyr/device.h>
#include <zephyr/drivers/gpio.h>
#include <zephyr/drivers/uart.h>
#include <ctype.h>
#include <stdio.h> 

 /* valosekvenssin vastaanotto sarjaportin kautta
    sarjaportti -> UART -> FIFO -> dispatcher  -> (condvar) -> valotaskit 
    
    HOX!! Lisätty vielä 7.10 +3p eli valotoiminnon ajastus example y500= yellow 500ms on*/ 

// Ledit
static const struct gpio_dt_spec red   = GPIO_DT_SPEC_GET(DT_ALIAS(led0), gpios);
static const struct gpio_dt_spec green = GPIO_DT_SPEC_GET(DT_ALIAS(led1), gpios);

// UART
#define UART_DEVICE_NODE DT_CHOSEN(zephyr_shell_uart)
static const struct device *const uart_dev = DEVICE_DT_GET(UART_DEVICE_NODE);

//FIFO-alkion tyyppi, pitää olla ennen K_FIFO..
struct seq_item {
    void *fifo_reserved;     
    char value;              /* 'R' / 'Y' / 'G' */
    uint32_t duration_ms;    /* kesto ms */
};
//UART taski tuottaa ja dispatcher lukee täältä
K_FIFO_DEFINE(seq_fifo);

static void enqueue_cmd(char color, uint32_t dur_ms) {
    struct seq_item *item = k_malloc(sizeof(*item));
    if (!item) { printk("malloc failed\n"); return; }
    item->value = color;
    item->duration_ms = dur_ms;
    k_fifo_put(&seq_fifo, item);
    printk("Enqueued: %c %u ms\n", color, dur_ms);
}

//release-sema-> taskeille ilmotus dispacher valmis
K_SEM_DEFINE(release_sem, 0, 1);

// Toimivat kimpassa (trig + mutex + condvar) jokaiselle värille
static volatile bool red_trig = false;
static volatile bool yel_trig = false;
static volatile bool grn_trig = false;

K_MUTEX_DEFINE(red_mutex);    K_CONDVAR_DEFINE(red_cv);
K_MUTEX_DEFINE(yellow_mutex); K_CONDVAR_DEFINE(yellow_cv);
K_MUTEX_DEFINE(green_mutex);  K_CONDVAR_DEFINE(green_cv);

//valon kesto
#define LIGHT_MS 1000 //oletus ilman erillistä antoa 1000ms
static volatile uint32_t red_dur_ms = LIGHT_MS;
static volatile uint32_t yel_dur_ms = LIGHT_MS;
static volatile uint32_t grn_dur_ms = LIGHT_MS;
static uint32_t current_ms = LIGHT_MS;  // yhteinen oletuskesto UART-komennoille


//Protot
static int init_led(void);
static int init_uart(void);
static int init_buttons(void);

void uart_task(void *, void *, void *);
void dispatcher_task(void *, void *, void *);
void red_led_task(void *, void *, void *);
void yellow_led_task(void *, void *, void *);
void green_led_task(void *, void *, void *);

//Napit takaisin
#define BUTTON_RED  DT_ALIAS(sw1)
#define BUTTON_YEL  DT_ALIAS(sw2)
#define BUTTON_GRN  DT_ALIAS(sw3)

static const struct gpio_dt_spec btn_red = GPIO_DT_SPEC_GET(BUTTON_RED, gpios);
static const struct gpio_dt_spec btn_yel = GPIO_DT_SPEC_GET(BUTTON_YEL, gpios);
static const struct gpio_dt_spec btn_grn = GPIO_DT_SPEC_GET(BUTTON_GRN, gpios);

static struct gpio_callback btn_red_cb;
static struct gpio_callback btn_yel_cb;
static struct gpio_callback btn_grn_cb;

//keskeytysten pikakäsittely -> työn ohjaus eteenpäin workille
static void btn_red_isr(const struct device *dev, struct gpio_callback *cb, uint32_t pins);
static void btn_yel_isr(const struct device *dev, struct gpio_callback *cb, uint32_t pins);
static void btn_grn_isr(const struct device *dev, struct gpio_callback *cb, uint32_t pins);

//napeille isr:n  kautta logiikka mitä tehdään k_malloc + k_fifo_put
static void red_work_fn(struct k_work *work);
static void yel_work_fn(struct k_work *work);
static void grn_work_fn(struct k_work *work);

K_WORK_DEFINE(red_work, red_work_fn);
K_WORK_DEFINE(yel_work, yel_work_fn);
K_WORK_DEFINE(grn_work, grn_work_fn);

/// Threadit
#define STACKSIZE 1024
#define PRIORITY  5
K_THREAD_DEFINE(uart_thread,       STACKSIZE, uart_task,       NULL,NULL,NULL, PRIORITY, 0, 0);
K_THREAD_DEFINE(dispatcher_thread, STACKSIZE, dispatcher_task, NULL,NULL,NULL, PRIORITY, 0, 0);
K_THREAD_DEFINE(red_thread,        STACKSIZE, red_led_task,    NULL,NULL,NULL, PRIORITY, 0, 0);
K_THREAD_DEFINE(yellow_thread,     STACKSIZE, yellow_led_task, NULL,NULL,NULL, PRIORITY, 0, 0);
K_THREAD_DEFINE(green_thread,      STACKSIZE, green_led_task,  NULL,NULL,NULL, PRIORITY, 0, 0);

int main(void)
{
    init_uart();
    init_led();
    init_buttons();

    printk("Ready to go! Type R/Y/G + optional ms (Y500) and press Enter.\n");
    return 0; 
}

//Initit uartilla ja ledeille ja myös buttoneille
static int init_uart(void) {
    if (!device_is_ready(uart_dev)) {
        printk("UART device not ready\n");
        return -ENODEV; // error ei laitettta..
    }
    return 0;
}
static int init_led(void) {
    int ret;

    if (!gpio_is_ready_dt(&red) || !gpio_is_ready_dt(&green)) {
        printk("LED ports not ready\n");
        return -ENODEV;
    }
    ret = gpio_pin_configure_dt(&red, GPIO_OUTPUT_ACTIVE);   if (ret) return ret;
    ret = gpio_pin_configure_dt(&green, GPIO_OUTPUT_ACTIVE); if (ret) return ret;

    gpio_pin_set_dt(&red,   0);
    gpio_pin_set_dt(&green, 0);

    printk("LEDs configured\n");
    return 0;
}
static int init_buttons(void) {
    int ret;

    if (!gpio_is_ready_dt(&btn_red) || !gpio_is_ready_dt(&btn_yel) || !gpio_is_ready_dt(&btn_grn)) {
        printk("Button ports not ready\n");
        return -ENODEV;
    }
    ret = gpio_pin_configure_dt(&btn_red, GPIO_INPUT);  if (ret) return ret;
    ret = gpio_pin_configure_dt(&btn_yel, GPIO_INPUT);  if (ret) return ret;
    ret = gpio_pin_configure_dt(&btn_grn, GPIO_INPUT);  if (ret) return ret;

    ret = gpio_pin_interrupt_configure_dt(&btn_red, GPIO_INT_EDGE_TO_ACTIVE); if (ret) return ret;
    ret = gpio_pin_interrupt_configure_dt(&btn_yel, GPIO_INT_EDGE_TO_ACTIVE); if (ret) return ret;
    ret = gpio_pin_interrupt_configure_dt(&btn_grn, GPIO_INT_EDGE_TO_ACTIVE); if (ret) return ret;

    gpio_init_callback(&btn_red_cb, btn_red_isr, BIT(btn_red.pin));
    gpio_add_callback(btn_red.port, &btn_red_cb);

    gpio_init_callback(&btn_yel_cb, btn_yel_isr, BIT(btn_yel.pin));
    gpio_add_callback(btn_yel.port, &btn_yel_cb);

    gpio_init_callback(&btn_grn_cb, btn_grn_isr, BIT(btn_grn.pin));
    gpio_add_callback(btn_grn.port, &btn_grn_cb);

    printk("Buttons configured (R/Y/G)\n");
    return 0;
}
// ISR:ssä ei allokointia tms, vain laukaise workki
static void btn_red_isr(const struct device *dev, struct gpio_callback *cb, uint32_t pins) {
    ARG_UNUSED(dev); ARG_UNUSED(cb); ARG_UNUSED(pins);
    k_work_submit(&red_work);
}
static void btn_yel_isr(const struct device *dev, struct gpio_callback *cb, uint32_t pins) {
    ARG_UNUSED(dev); ARG_UNUSED(cb); ARG_UNUSED(pins);
    k_work_submit(&yel_work);
}
static void btn_grn_isr(const struct device *dev, struct gpio_callback *cb, uint32_t pins) {
    ARG_UNUSED(dev); ARG_UNUSED(cb); ARG_UNUSED(pins);
    k_work_submit(&grn_work);
}

//workit.. siirretään täällä myös aika->LIHGT ajaksi, mikäli annettu
static void red_work_fn(struct k_work *work) {
    struct seq_item *item = k_malloc(sizeof(*item));
    if (item) { item->value = 'R'; item->duration_ms = current_ms; k_fifo_put(&seq_fifo, item); printk("BTN -> R\n"); }
}
static void yel_work_fn(struct k_work *work) {
    struct seq_item *item = k_malloc(sizeof(*item));
    if (item) { item->value = 'Y'; item->duration_ms = current_ms; k_fifo_put(&seq_fifo, item); printk("BTN -> Y\n"); }
}
static void grn_work_fn(struct k_work *work) {
    struct seq_item *item = k_malloc(sizeof(*item));
    if (item) { item->value = 'G'; item->duration_ms = current_ms; k_fifo_put(&seq_fifo, item); printk("BTN -> G\n"); }
}

/* UART
   - kerää merkit linebufiin, kunnes ENTER
   - riviltä poimitaan R/Y/G:t ja numerot current_ms:ksi. Jos ei numeroa niin käytetään viimeisin current ms */  
void uart_task(void *a, void *b, void *c) {
    #define MAX_LINE 64
    static char linebuf[MAX_LINE];
    size_t len = 0;
    char rc;

    while (1) {
        /* lue kaikki saatavilla olevat tavut ennen nukkumista */
        while (uart_poll_in(uart_dev, &rc) == 0) {
            char ch = rc;

            if (ch == '\r' || ch == '\n') {
                /* rivi valmis -> tulkitaan */
                linebuf[len] = '\0';
                if (len > 0) {
                    char colors[32];      size_t n = 0;
                    unsigned cur = 0, last = 0;
                    bool in_num = false, have_num = false;

                    for (size_t i = 0; i < len; ++i) {
                        char c = (char)toupper((unsigned char)linebuf[i]);

                        if (c == 'R' || c == 'Y' || c == 'G') {
                            if (n < sizeof(colors)) colors[n++] = c;
                            if (in_num) { last = cur; have_num = true; in_num = false; }
                        } else if (c >= '0' && c <= '9') {
                            if (!in_num) { cur = 0; in_num = true; }
                            if (cur < 60000 / 10) cur = cur * 10u + (unsigned)(c - '0');
                        } else {
                            if (in_num) { last = cur; have_num = true; in_num = false; }
                        }
                    }
                    if (in_num) { last = cur; have_num = true; }

                    if (have_num) {
                        if (last < 1) last = 1;
                        if (last > 60000) last = 60000;
                        current_ms = last;
                        printk("Set duration: %u ms\n", current_ms);
                    }

                    if (n > 0) {
                        for (size_t i = 0; i < n; ++i) {
                            enqueue_cmd(colors[i], current_ms);
                        }
                    } else if (!have_num) {
                        printk("NOT valid line: '%s' (use R/Y/G and/or number)\n", linebuf);
                    }
                    len = 0;
                }
            } else if (ch == 0x08 || ch == 0x7F) {
                /* backspace */
                if (len) --len;
            } else if (isprint((unsigned char)ch) || ch == ' ') {
                /* kerää syöte puskuriin */
                if (len < MAX_LINE - 1) {
                    linebuf[len++] = ch;
                } else {
                    len = 0;
                    printk("UART line overflow, dropping\n");
                }
            } else {
                /* muut merkit ohitetaan */
            }
        }
        k_msleep(1);
    }
}
//Dispatcher. FIFO:sta merkki kerrallaan. lukitsee vastaavan mutexin, asettaa trig-lipun, 
//signaloi condvarin -> herättää valotaskin. odottaa release-semaa, joka taskilta kun valmista
void dispatcher_task(void *a, void *b, void *c) {
    printk("Dispatcher started\n");
    while (1) {
        struct seq_item *it = k_fifo_get(&seq_fifo, K_FOREVER); // merkki kerrallaan
        char ch = it->value; // poimitaan FIFO-alkioista kirjaimet
        uint32_t dur = it->duration_ms; //valojen ajastukseen
        k_free(it); //vapautetaan heap-muisti

        switch (ch) {
            case 'R':
                k_mutex_lock(&red_mutex, K_FOREVER); //lukitaan kirjainta vastaava mutex
                red_dur_ms = dur;
                red_trig = true;                    // ja asetaan siitä lippu valmiina hommille
                k_condvar_signal(&red_cv);          // herätetään oikea valotaskille
                k_mutex_unlock(&red_mutex);         // mutexin  vapautus
                printk("Dispatch -> RED (%u ms)\n", dur);
                break;

            case 'Y':
                k_mutex_lock(&yellow_mutex, K_FOREVER);
                yel_dur_ms = dur;
                yel_trig = true;
                k_condvar_signal(&yellow_cv);
                k_mutex_unlock(&yellow_mutex);
                printk("Dispatch -> YELLOW (%u ms)\n", dur);
                break;

            case 'G':
                k_mutex_lock(&green_mutex, K_FOREVER);
                grn_dur_ms = dur;
                grn_trig = true;
                k_condvar_signal(&green_cv);
                k_mutex_unlock(&green_mutex);
                printk("Dispatch -> GREEN (%u ms)\n", dur);
                break;
            default:
                continue; // varalta jos merkki ei ole y,g, tai r ei odoteta releasea vaan jatketaan seuraavaan.
        }
        //Odota että single-shot valmistuu ennen seuraavaa merkkiä
        k_sem_take(&release_sem, K_FOREVER);
    }
}
//Taskit valoille
// Odottaa condvaria while-silmukassa, kun red_trig on tosi, nollaa sen, sytyttää valon LIGHT_MS/ DUR ajaksi
// Lopuksi release-sema -> dispatcher saa jatkaa seuraavaan merkkiin
void red_led_task(void *, void *, void*) {
    printk("Red task started\n");
    while (1) {
        k_mutex_lock(&red_mutex, K_FOREVER);
        while (!red_trig) {
            k_condvar_wait(&red_cv, &red_mutex, K_FOREVER);// Wait vapauttaa mutexin nukkuessa ja lukitsee sen uudelleen herätessä
        }
        red_trig = false; //työtä tarjolla
        uint32_t dur = red_dur_ms;
        k_mutex_unlock(&red_mutex);
        
        gpio_pin_set_dt(&red, 1);  printk("RED ON\n");
        k_msleep(dur);
        gpio_pin_set_dt(&red, 0);  printk("RED OFF\n");

        k_sem_give(&release_sem); //dispatcherille tieto valmista on
    }
}
void yellow_led_task(void *, void *, void*) {
    printk("Yellow task started\n");
    while (1) {
        k_mutex_lock(&yellow_mutex, K_FOREVER);
        while (!yel_trig) {
            k_condvar_wait(&yellow_cv, &yellow_mutex, K_FOREVER);
        }
        yel_trig = false;
        uint32_t dur = yel_dur_ms;
        k_mutex_unlock(&yellow_mutex);

        // keltainen= punainen + vihreä yhtä aikaa
        gpio_pin_set_dt(&red,   1);
        gpio_pin_set_dt(&green, 1);
        printk("YELLOW ON\n");
        k_msleep(dur);
        gpio_pin_set_dt(&red,   0);
        gpio_pin_set_dt(&green, 0);
        printk("YELLOW OFF\n");

        k_sem_give(&release_sem);
    }
}
void green_led_task(void *, void *, void*) {
    printk("Green task started\n");
    while (1) {
        k_mutex_lock(&green_mutex, K_FOREVER);
        while (!grn_trig) {
            k_condvar_wait(&green_cv, &green_mutex, K_FOREVER);
        }
        grn_trig = false;
        uint32_t dur = grn_dur_ms;
        k_mutex_unlock(&green_mutex);

        gpio_pin_set_dt(&green, 1);  printk("GREEN ON\n");
        k_msleep(dur);
        gpio_pin_set_dt(&green, 0);  printk("GREEN OFF\n");

        k_sem_give(&release_sem);
    }
}
```

## src/TimeParser.cpp
```c
#include <stdlib.h>
#include <string.h>
#include "TimeParser.h"

// time format: HHMMSS (6 characters)
int time_parse(char *time) {

	// how many seconds, default returns error
	int seconds = TIME_LEN_ERROR;

	// TODO: Check that string is not null

	// Parse values from time string
	// For example: 124033 -> 12hour 40min 33sec
    int values[3];
	values[2] = atoi(time+4); // seconds
	time[4] = 0;
	values[1] = atoi(time+2); // minutes
	time[2] = 0;
	values[0] = atoi(time); // hours
	// Now you have:
	// values[0] hour
	// values[1] minute
	// values[2] second

	// TODO: Add boundary check time values: below zero or above limit not allowed
	// limits are 59 for minutes, 23 for hours, etc

	// TODO: Calculate return value from the parsed minutes and seconds
	// Otherwise error will be returned!
	// seconds = ...

	return seconds;
}
```

## src/TimeParser.h
```c
#ifndef TIMEPARSER_H
#define TIMEPARSER_H

// Error codes
#define TIME_LEN_ERROR      -1
#define TIME_ARRAY_ERROR    -2
#define TIME_VALUE_ERROR    -3

using namespace std;

int time_parse(char *time);

#endif
```

## src/led.c
```c
#include <zephyr/kernel.h>
#include <zephyr/sys/printk.h>
#include <zephyr/device.h>
#include <zephyr/drivers/gpio.h>

// Led pin configurations
static const struct gpio_dt_spec red = GPIO_DT_SPEC_GET(DT_ALIAS(led0), gpios);
static const struct gpio_dt_spec green = GPIO_DT_SPEC_GET(DT_ALIAS(led1), gpios);
static const struct gpio_dt_spec blue = GPIO_DT_SPEC_GET(DT_ALIAS(led2), gpios);

// Red led thread initialization
#define STACKSIZE 500
#define PRIORITY 5
void red_led_task(void *, void *, void*);
void green_led_task(void *, void *, void*);
void blue_led_task(void *, void *, void*);

K_THREAD_DEFINE(red_thread,STACKSIZE,red_led_task,NULL,NULL,NULL,PRIORITY,0,0);
K_THREAD_DEFINE(green_thread,STACKSIZE,green_led_task,NULL,NULL,NULL,PRIORITY,0,0);
K_THREAD_DEFINE(blue_thread,STACKSIZE,blue_led_task,NULL,NULL,NULL,PRIORITY,0,0);


// Initialize leds
int  init_led() {

	// Led pin initialization
	int ret = gpio_pin_configure_dt(&red, GPIO_OUTPUT_ACTIVE);
	if (ret < 0) {
		printk("Error: Led configure failed\n");		
		return ret;
	}
	// set led off
	gpio_pin_set_dt(&red,0);

	int green = gpio_pin_configure_dt(&green, GPIO_OUTPUT_ACTIVE);
	if (green < 0) {
		printk("Error: Led configure failed\n");		
		return green;
	}
	// set led off
	gpio_pin_set_dt(&green,0);

	int blue = gpio_pin_configure_dt(&blue, GPIO_OUTPUT_ACTIVE);
	if (blue < 0) {
		printk("Error: Led configure failed\n");		
		return blue;
	}
	// set led off
	gpio_pin_set_dt(&blue,0);

	printk("Led initialized ok\n");
	
	return 0;
}

// Task to handle red led
void red_led_task(void *, void *, void*) {
	
	printk("Red led thread started\n");
	while (true) {
		// 1. set led on 
		gpio_pin_set_dt(&red,1);
		printk("Red on\n");
		// 2. sleep for 2 seconds
		k_sleep(K_SECONDS(1));
		// 3. set led off
		gpio_pin_set_dt(&red,0);
		printk("Red off\n");
		// 4. sleep for 2 seconds
		k_sleep(K_SECONDS(1));
	}
}
//task to handle  green light
void green_led_task(void *, void *, void*) {
	
	printk("Green led thread started\n");
	while (true) {
		// 1. set led on 
		gpio_pin_set_dt(&green,1);
		printk("green on\n");
		// 2. sleep for 2 seconds
		k_sleep(K_SECONDS(1));
		// 3. set led off
		gpio_pin_set_dt(&green,0);
		printk("green off\n");
		// 4. sleep for 2 seconds
		k_sleep(K_SECONDS(1));
	}
}

//task to handle blue light
void blue_led_task(void *, void *, void*) {
	
	printk("Blue led thread started\n");
	while (true) {
		// 1. set led on 
		gpio_pin_set_dt(&blue,1);
		printk("Blue on\n");
		// 2. sleep for 2 seconds
		k_sleep(K_SECONDS(1));
		// 3. set led off
		gpio_pin_set_dt(&blue,0);
		printk("Blue off\n");
		// 4. sleep for 2 seconds
		k_sleep(K_SECONDS(1));
	}
}
```
